## samples/kernel/condition_variables/condvar/sample.yaml
```yaml
tests:
  zpp.sample.kernel.cond_var:
    arch_exclude: posix
    platform_exclude: qemu_x86_coverage
    tags: zpp kernel condition_variables
    harness: console
    harness_config:
      type: one_line
      regex:
        - ".*Waited and joined with 3 threads"
```

## tests/compile/testcase.yaml
```yaml
tests:
  zpp.compile:
    arch_exclude: posix
    platform_exclude: qemu_x86_coverage
    build_only: true
    tags: cpp zpp
```

## tests/condition_variable/testcase.yaml
```yaml
tests:
  zpp.condition_variable:
    arch_exclude: posix
    platform_exclude: qemu_x86_coverage
    tags: cpp zpp
```

## tests/mem_pool/testcase.yaml
```yaml
tests:
  zpp.mem_pool:
    arch_exclude: x86_64 posix
    platform_exclude: qemu_x86_coverage
    tags: cpp zpp
```

## tests/mem_slab/testcase.yaml
```yaml
tests:
  zpp.mem_slab:
    arch_exclude: x86_64 posix
    platform_exclude: qemu_x86_coverage
    tags: cpp zpp
```

## tests/result/testcase.yaml
```yaml
tests:
  zpp.result:
    arch_exclude: posix
    platform_exclude: qemu_x86_coverage
    tags: cpp zpp
```

## tests/thread/testcase.yaml
```yaml
tests:
  zpp.thread:
    arch_exclude: x86_64 posix
    platform_exclude: qemu_x86_coverage
    tags: cpp zpp
```

## tests/timer/testcase.yaml
```yaml
tests:
  zpp.timer:
    slow: true
    arch_exclude: posix
    platform_exclude: qemu_x86_coverage
    tags: cpp zpp
```
