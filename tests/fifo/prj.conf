## CMakeLists.txt
```
# SPDX-License-Identifier: Apache-2.0

cmake_minimum_required(VERSION 3.20.0)
find_package(Zephyr REQUIRED HINTS $ENV{ZEPHYR_BASE})
project(zpp_fifo)

FILE(GLOB app_sources src/*.cpp)
target_sources(app PRIVATE ${app_sources})
```

## prj.conf
```kconfig
CONFIG_CPLUSPLUS=y
CONFIG_STD_CPP2A=y
CONFIG_NEWLIB_LIBC=y
CONFIG_ASSERT=y
CONFIG_ZTEST=y
CONFIG_SPEED_OPTIMIZATIONS=y
```

## src/main.cpp
```c
//
// Copyright (c) 2019 Erwin Rol <erwin@erwinrol.com>
//
// SPDX-License-Identifier: Apache-2.0
//

#include <zephyr/ztest.h>

#include <zephyr/kernel.h>

#include <zpp/fifo.hpp>
#include <zpp/thread.hpp>
#include <zpp/sem.hpp>

#include <array>

ZTEST_SUITE(test_zpp_fifo, NULL, NULL, NULL, NULL, NULL);

namespace {

ZPP_THREAD_STACK_DEFINE(tstack, 1024);
zpp::thread_data tcb;

struct item {
  void* fifo_reserved{};
  uint32_t data{};
  uint32_t more_data{};
};

std::array<item, 4> g_item_array;

zpp::fifo<item> g_fifo;

} // namespace

ZTEST(test_zpp_fifo, test_fifo)
{
  using namespace zpp;
  using namespace std::chrono;

  const thread_attr attr(
        thread_prio::preempt(0),
        thread_inherit_perms::yes,
        thread_essential::no,
        thread_suspend::no
      );

  //
  // Put items into fifo
  //
  for (auto& item: g_item_array) {
    item.data = 0x1234;
    item.more_data = 0x5678;
    g_fifo.push_back(&item);
  }

  auto t = thread(
    tcb, tstack(), attr,
    []() noexcept {
      //
      // Get items from fifo
      //
      for (auto& item: g_item_array) {
        auto res = g_fifo.try_pop_front();
        zassert_equal(res->data, 0x1234, nullptr);
        zassert_equal(res->more_data, 0x5678, nullptr);
        zassert_equal(res, &item, nullptr);
      }

      //
      // Put items into fifo
      //
      for (auto& item: g_item_array) {
        g_fifo.push_back(&item);
      }
    });

  //
  // Let the child thread run
  //
  auto res = t.join();
  zassert_equal(!!res, true, "");

  //
  // Get items from fifo
  //
  for (auto& item:  g_item_array) {
    auto res = g_fifo.try_pop_front();
    zassert_equal(res->data, 0x1234, nullptr);
    zassert_equal(res->more_data, 0x5678, nullptr);
    zassert_equal(res, &item, nullptr);
  }
}
```
