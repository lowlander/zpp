## CMakeLists.txt
```
# SPDX-License-Identifier: Apache-2.0

cmake_minimum_required(VERSION 3.20.0)
find_package(Zephyr REQUIRED HINTS $ENV{ZEPHYR_BASE})
project(zpp_timer)

FILE(GLOB app_sources src/*.cpp)
target_sources(app PRIVATE ${app_sources})
```

## prj.conf
```kconfig
CONFIG_CPLUSPLUS=y
CONFIG_STD_CPP20=y
CONFIG_NEWLIB_LIBC=y
CONFIG_ZTEST=y
CONFIG_ZTEST_NEW_API=y
CONFIG_ZTEST_FATAL_HOOK=y
CONFIG_ASSERT=y
CONFIG_SPEED_OPTIMIZATIONS=y
CONFIG_LIB_CPLUSPLUS=y
CONFIG_COMPILER_OPT="-Wall -Wextra -Werror -Wno-error=empty-body -Wno-error=unused-parameter -Wno-error=type-limits -Wno-error=missing-field-initializers -Wno-error=sign-compare -Wno-error=ignored-qualifiers -Wno-error=old-style-declaration -Wno-error=cast-function-type"
```

## src/main.cpp
```c
/*
* Copyright (c) 2019 Erwin Rol <erwin@erwinrol.com>
*
* SPDX-License-Identifier: Apache-2.0
*/

#include <zephyr/ztest.h>

#include <zephyr/kernel.h>

#include <zpp/timer.hpp>
#include <zpp/thread.hpp>
#include <zpp/fmt.hpp>

ZTEST_SUITE(zpp_timer_tests, NULL, NULL, NULL, NULL, NULL);

namespace {

auto g_t = zpp::make_timer();

void timer_callback(zpp::timer_base* t) noexcept
{
  zpp::print("Hello from timer tid={}\n", zpp::this_thread::get_id());
}

} // namespace

ZTEST(zpp_timer_tests, test_timer_creation_function)
{
  using namespace zpp;
  using namespace std::chrono;

  auto t = make_timer(timer_callback);
  t.start(100ms, 1s);

  this_thread::sleep_for(5s);
}

ZTEST(zpp_timer_tests, test_timer_creation_lambda)
{
  using namespace zpp;
  using namespace std::chrono;

  auto t = make_timer(
    [] (auto t) {
      print("Hello from timer tid={}\n",
          this_thread::get_id());
    } );

  t.start(100ms, 1s);

  this_thread::sleep_for(5s);
}
```
