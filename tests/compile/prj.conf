## CMakeLists.txt
```
# SPDX-License-Identifier: Apache-2.0

cmake_minimum_required(VERSION 3.20.0)
find_package(Zephyr REQUIRED HINTS $ENV{ZEPHYR_BASE})
project(zpp_compile)

FILE(GLOB app_sources src/*.cpp)
target_sources(app PRIVATE ${app_sources})
```

## prj.conf
```kconfig
CONFIG_CPLUSPLUS=y
CONFIG_STD_CPP2A=y
CONFIG_NEWLIB_LIBC=y
CONFIG_NEWLIB_LIBC_NANO=y
CONFIG_ASSERT=y
CONFIG_ZTEST=y
CONFIG_SPEED_OPTIMIZATIONS=y
```

## src/main.cpp
```c
/*
 * Copyright (c) 2019 Erwin Rol <erwin@erwinrol.com>
 *
 * SPDX-License-Identifier: Apache-2.0
 */

/*
 * Simple test to check if all zpp headers are error free
 */

#include <zephyr/ztest.h>

#include <zephyr/kernel.h>

#include <zpp.hpp>

ZTEST_SUITE(zpp_compile_tests, NULL, NULL, NULL, NULL, NULL);

//
// check compile time power_of_two function
//
static_assert(zpp::power_of_two(0) == 1);
static_assert(zpp::power_of_two(1) == 2);
static_assert(zpp::power_of_two(2) == 4);
static_assert(zpp::power_of_two(3) == 8);
static_assert(zpp::power_of_two(4) == 16);
static_assert(zpp::power_of_two(10) == 1024);
static_assert(zpp::power_of_two(20) == 1048576);

//
// check compile time is_power_of_two function
//
static_assert(zpp::is_power_of_two(1) == true);
static_assert(zpp::is_power_of_two(2) == true);
static_assert(zpp::is_power_of_two(4) == true);
static_assert(zpp::is_power_of_two(8) == true);
static_assert(zpp::is_power_of_two(16) == true);
static_assert(zpp::is_power_of_two(3) == false);
static_assert(zpp::is_power_of_two(100) == false);

//
// check compile time is_multiple_of function
//
static_assert(zpp::is_multiple_of(0, 0) == false);
static_assert(zpp::is_multiple_of(4, 4) == true);
static_assert(zpp::is_multiple_of(6, 3) == true);
static_assert(zpp::is_multiple_of(10, 3) == false);
```
