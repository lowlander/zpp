## CMakeLists.txt
```
# SPDX-License-Identifier: Apache-2.0

cmake_minimum_required(VERSION 3.20.0)
find_package(Zephyr REQUIRED HINTS $ENV{ZEPHYR_BASE})
project(zpp_atomic)

FILE(GLOB app_sources src/*.cpp)
target_sources(app PRIVATE ${app_sources})
```

## prj.conf
```kconfig
CONFIG_CPLUSPLUS=y
CONFIG_STD_CPP20=y
CONFIG_NEWLIB_LIBC=y
CONFIG_ASSERT=y
CONFIG_ZTEST=y
CONFIG_ZTEST_NEW_API=y
CONFIG_ZTEST_FATAL_HOOK=y
CONFIG_SPEED_OPTIMIZATIONS=y
CONFIG_LIB_CPLUSPLUS=y
CONFIG_COMPILER_OPT="-Wall -Wextra -Werror -Wno-error=empty-body -Wno-error=unused-parameter -Wno-error=type-limits -Wno-error=missing-field-initializers -Wno-error=sign-compare -Wno-error=ignored-qualifiers -Wno-error=old-style-declaration -Wno-error=cast-function-type"
```

## src/main.cpp
```c
/*
* Copyright (c) 2019 Erwin Rol <erwin@erwinrol.com>
*
* SPDX-License-Identifier: Apache-2.0
*/

#include <zephyr/ztest.h>

#include <zephyr/kernel.h>

#include <zpp/atomic_bitset.hpp>
#include <zpp/atomic_var.hpp>


ZTEST_SUITE(zpp_atomic_tests, NULL, NULL, NULL, NULL, NULL);

namespace {

zpp::atomic_bitset<320> g_bitset;

} // namespace

ZTEST(zpp_atomic_tests, test_atomic_bitset)
{
  g_bitset.store(0, true);
  zassert_true(g_bitset.load(0) == true, "load(0) failed");

  g_bitset.store(319, true);
  zassert_true(g_bitset.load(319) == true, "load(319) failed");
}
```
